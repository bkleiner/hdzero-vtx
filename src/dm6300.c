#include "dm6300.h"

#include "driver/spi.h"

#include "debug.h"
#include "eeprom.h"

dm6300_efuse_t efuse;

uint32_t freq_cnt = 0;
uint32_t freq_num[FREQ_MAX_EXT] = {0};

uint8_t power_table[FREQ_MAX_EXT][POWER_MAX];

const uint32_t freq_tab[FREQ_MAX_EXT] = {113200, 113900, 114700, 115400, 116100, 116780, 117560, 118280, 115200, 116000};
const uint32_t freq_reg_tab[3][FREQ_MAX_EXT] = {
    {0x3867, 0x379D, 0x3924, 0x3982, 0x39E1, 0x3A3F, 0x3A9E, 0x3AFC, 0x3840, 0x38A4},
    {0x93, 0x94, 0x95, 0x96, 0x97, 0x98, 0x99, 0x9a, 0x96, 0x97},
    {0xB00000, 0x9D5555, 0x8AAAAB, 0x780000, 0x655555, 0x52AAAB, 0x400000, 0x2D5555, 0x000000, 0x155555},
};

#ifdef VTX_L
const uint16_t power_reg_tab[4] = {0x204, 0x11F, 0x21F, 0x31F};
#else
const uint16_t power_reg_tab[2] = {0x21F, 0x41F};
#endif

void dm6300_read_efuse() {
    debugf("dm6300 efuse size %d\r\n", sizeof(dm6300_efuse_t));

    // EFUSE_RST = 1;
    spi_write(0x6, 0xFF0, 0x00000019);
    spi_write(0x3, 0x0E0, 0x00000001);

    spi_write(0x6, 0xFF0, 0x00000018);

    uint8_t val = 0;
    uint32_t dat = 0;
    uint8_t efuse_busy = 1;
    for (uint8_t j = 0; j < EFUSE_NUM; j++) {
        debugf("dm6300 reading efuse %d\r\n", j);

        for (uint8_t i = 0; i < EFUSE_SIZE; i++) {
            spi_write(0x3, 0x7D0, (j << 11) | (i << 4) | 0x1);

            while (efuse_busy) {
                spi_read(0x3, 0x7D4, &dat);
                efuse_busy = dat & 1;
            }
            efuse_busy = 1;

            spi_read(0x3, 0x7D8, &dat);
            val = dat & 0xFF;
            efuse.raw[j][i] = val;
        }
#ifdef DEBUG_EFUSE
        debug_hex(efuse.raw[j], EFUSE_SIZE);
        debugf("\r\n");
#endif
    }

    // EFUSE_CFG = 0;
    spi_write(0x3, 0x7D0, 0x00000000);
    // EFUSE_RST = 0;
    spi_write(0x6, 0xFF0, 0x00000019);
    spi_write(0x3, 0x0E0, 0x00000000);

    spi_write(0x6, 0xF14, efuse.macros.m1.bandgap);
    dat = ((efuse.macros.m1.ical & 0x1F) << 3) | (efuse.macros.m1.rcal & 0x7);
    spi_write(0x6, 0xF18, dat);

    spi_write(0x6, 0xFF0, 0x00000018);
}

const spi_reg_value_t dm6300_init0_regs[] = {
    {0x6, 0xFFC, 0x00000000},
    {0x6, 0xFFC, 0x00000001},
    {0x6, 0x7FC, 0x00000000},
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    {0x6, 0xFFC, 0x00000001},
};

const spi_reg_value_t dm6300_init1_regs[] = {
    {0x6, 0xFF0, 0x00000018},
    {0x3, 0x2B0, 0x00077777},
    {0x3, 0x030, 0x00000013},
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    {0x3, 0x018, 0x00000000}};

const spi_reg_value_t dm6300_init2_regs_bw20[] = {
    {0x6, 0xFF0, 0x00000018},
    {0x3, 0x2AC, 0x00000300},
    {0x3, 0x2B0, 0x00007007},
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    {0x3, 0x258, 0x00010003},
};
const spi_reg_value_t dm6300_init2_regs_bw27[] = {
    // 02_BBPLL_3456
    {0x6, 0xFF0, 0x00000018},
    {0x3, 0x2AC, 0x00000300},
    {0x3, 0x2B0, 0x00077777},
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    {0x3, 0x258, 0x00010002},
};

spi_reg_value_t dm6300_set_channel_regs[] = {
    // 03_RFPLL_CA1_TX_10G
    {0x6, 0xFF0, 0x00000018},
    {0x3, 0x2B0, 0x00077777},
    {0x3, 0x030, 0x00000013},
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    {0x3, 0x054, 0x1F3C3440},
    // {0x3, 0x028, 0x00008030},
    {0x3, 0x028, 0x00000000}, // [12] // 0x00008000 + (freq_cnt & 0xFF)
    // {0x3, 0x020, 0x00003746},
    {0x3, 0x020, 0x00000000}, // [13] // freq_num[ch]}, // freq_reg_tab[0][ch] WAIT(1},
    {0x3, 0x01C, 0x00000002},
    {0x3, 0x018, 0x00000001},
    {0x3, 0x018, 0x00000000},
    // {0x3, 0x028, 0x00008030},
    {0x3, 0x028, 0x00000000}, // [17] // 0x00008000 + (freq_cnt & 0xFF)},
    // {0x3, 0x020, 0x00003746},
    {0x3, 0x020, 0x00000000}, // [18] // freq_num[ch]}, // freq_reg_tab[0][ch]
    {0x3, 0x01C, 0x00000003},
    {0x3, 0x018, 0x00000001},
    {0x3, 0x018, 0x00000000},
    {0x3, 0x050, 0x00FFCFB3},
    // {0x3, 0x004, 0x00000093},
    // {0x3, 0x008, 0x00CAAAAB},
    {0x3, 0x004, 0x00000000}, // [23] // freq_reg_tab[1][ch]},
    {0x3, 0x008, 0x00000000}, // [24] // freq_reg_tab[2][ch]},
    {0x3, 0x000, 0x00000000},
    {0x3, 0x000, 0x00000003},
    {0x3, 0x050, 0x000333B3},
    {0x3, 0x040, 0x07070002},
    {0x3, 0x030, 0x00000010},
};

void dm6300_set_channel(uint8_t ch) {
    if (ch >= FREQ_MAX_EXT) {
        ch = 0;
    }

    dm6300_set_channel_regs[12].dat = 0x00008000 + (freq_cnt & 0xFF);
    dm6300_set_channel_regs[13].dat = freq_num[ch]; // freq_reg_tab[0][ch] WAIT(1);

    dm6300_set_channel_regs[17].dat = 0x00008000 + (freq_cnt & 0xFF);
    dm6300_set_channel_regs[18].dat = freq_num[ch]; // freq_reg_tab[0][ch]

    dm6300_set_channel_regs[23].dat = freq_reg_tab[1][ch];
    dm6300_set_channel_regs[24].dat = freq_reg_tab[2][ch];

    SPI_WRITE_REG_MAP(dm6300_set_channel_regs);
}

const spi_reg_value_t dm6300_init4_regs[] = {
    // 04_TX_CA1_RF
    {0x6, 0xFF0, 0x00000018},
    {0x3, 0x31C, 0x00000000}, // 0x00000030
    {0x3, 0x300, 0xC000281B},
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    {0x3, 0x31C, 0x00000011},
};

const spi_reg_value_t dm6300_init5_regs[] = {
    // 05_tx_cal_DAC_BBF
    {0x6, 0xFF0, 0x00000019},
    {0x3, 0x194, 0x0001FFFF},
    {0x6, 0xFF0, 0x00000018},
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    {0x3, 0x388, 0x075F8000},
};

spi_reg_value_t dm6300_init6_regs[] = {
    {0x6, 0xFF0, 0x00000019},
    {0x3, 0x0E4, 0x00000002},
    {0x3, 0x0E8, 0x0000000D},
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    {0x3, 0x080, 0x00000000}, // [10]

    // if (sel)
    //     spi_write(0x3, 0x080, 0x16318C0C);
    // else
    //     spi_write(0x3, 0x080, 0x1084210C);

    {0x3, 0x020, 0x0000000C},
    {0x3, 0x018, 0x04F16040},
    {0x3, 0x088, 0x00000085},

    {0x6, 0xFF0, 0x00000018},
    {0x3, 0xD08, 0x03200300},
    {0x3, 0xD0C, 0x00000000},
};

void dm6300_init6() {
    dm6300_init6_regs[10].dat = DM6300_BW ? 0x16318C0C : 0x1084210C;
    SPI_WRITE_REG_MAP(dm6300_init6_regs);
}

const spi_reg_value_t dm6300_init7_regs_bw20[] = {
    {0x6, 0xFF0, 0x00000018},
    {0x3, 0xC00, 0x005B0047},
    {0x3, 0xC04, 0xFFBB0017},
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    {0x3, 0xCFC, 0x0047005B},
};
const spi_reg_value_t dm6300_init7_regs_bw27[] = {
    // 07_fir_128stap
    {0x6, 0xFF0, 0x00000018},
    {0x3, 0xC00, 0x004E0041},
    {0x3, 0xC04, 0x0053005D},
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    {0x3, 0xCFC, 0x0041004E},
};

void dm6300_configure_efuse() {
    debugf("dm6300 efuse bands\r\n");

    for (uint8_t i = 0; i < efuse.macros.m0.band_num; i++) {
        debugf("%d: start=%u, stop=%u\r\n", i, efuse.macros.m2[i].tx1.freq_start, efuse.macros.m2[i].tx1.freq_stop);

        if (efuse.macros.m2[i].tx1.freq_start < 5000 || efuse.macros.m2[i].tx1.freq_stop > 6000) {
            continue;
        }

        if ((efuse.macros.m0.efuse_ver[1] == '2') && (efuse.macros.m0.efuse_ver[3] == '3')) {
            efuse.macros.m2[i].tx1.dcoc_i = efuse.macros.m2[i].tx1.dcoc_i_dvm;
            efuse.macros.m2[i].tx1.dcoc_q = efuse.macros.m2[i].tx1.dcoc_q_dvm;
        } else {
            efuse.macros.m2[i].tx1.dcoc_i = efuse.macros.m2[i].tx1.dcoc_i;
            efuse.macros.m2[i].tx1.dcoc_q = efuse.macros.m2[i].tx1.dcoc_q;
        }

        if ((efuse.macros.m0.efuse_ver[1] == '2') && (efuse.macros.m0.efuse_ver[3] == '2')) {
            uint32_t ef_data = efuse.macros.m2[i].tx1.dcoc_i;
            ef_data = (ef_data & 0xFFFF8000) | ((((((ef_data & 0x00007f7f) + 0x00000202) >> 2) & 0x00001f1f)) | 0x00000080);
            efuse.macros.m2[i].tx1.dcoc_i = ef_data;

            ef_data = efuse.macros.m2[i].tx1.dcoc_q;
            ef_data = (ef_data & 0xFFFF8000) | ((((((ef_data & 0x00007f7f) + 0x00000202) >> 2) & 0x00001f1f)) | 0x00000080);
            efuse.macros.m2[i].tx1.dcoc_q = ef_data;
        }

        spi_write(0x3, 0xD08, efuse.macros.m2[i].tx1.iqmismatch);
        spi_write(0x3, 0x380, efuse.macros.m2[i].tx1.dcoc_i);
        spi_write(0x3, 0x388, efuse.macros.m2[i].tx1.dcoc_q);

        debugf("iqmismatch=%lx\r\n", efuse.macros.m2[i].tx1.iqmismatch);
        debugf("dcoc_i=%lx\r\n", efuse.macros.m2[i].tx1.dcoc_i);
        debugf("dcoc_q=%lx\r\n", efuse.macros.m2[i].tx1.dcoc_q);

        // TODO: settings from EEPROM
    }

    debugf("\r\n");
}

void dm6300_init_power_table() {
    debugf("dm6300 init power table\r\n");

    for (uint8_t j = 0; j < POWER_MAX; j++) {
        for (uint8_t i = 0; i < FREQ_MAX; i++) {
            power_table[i][j] = storage->power_table[i * POWER_MAX + j];
            if (j == 0) {
                power_table[i][j] += 0x0C;
            }
        }

        power_table[8][j] = storage->power_table[3 * POWER_MAX + j];
        power_table[9][j] = storage->power_table[4 * POWER_MAX + j];
        if (j == 0) { // 25mw +3dbm
            power_table[8][j] += 0x0C;
            power_table[9][j] += 0x0C;
        }
    }

    for (uint8_t i = 0; i < FREQ_MAX_EXT; i++) {
        debugf("power_table[%d] =", i);
        for (uint8_t j = 0; j < POWER_MAX; j++) {
            debugf(" %02X", power_table[i][j]);
        }
        debugf("\r\n");
    }
}

void dm6300_init(uint8_t ch) {
    debugf("dm6300 init\r\n");

    // 01_INIT
    SPI_WRITE_REG_MAP(dm6300_init0_regs);
    dm6300_read_efuse();
    SPI_WRITE_REG_MAP(dm6300_init1_regs);

    uint32_t dat = 0;
    spi_read(0x3, 0x02C, &dat);
    freq_cnt = dat & 0x3FFF;
    freq_cnt = 0x20000 / freq_cnt - 3;
    for (uint8_t i = 0; i < FREQ_MAX_EXT; i++) {
        freq_num[i] = freq_tab[i] * freq_cnt / 384;
    }

    // 02_BBPLL_3456
    if (DM6300_BW) {
        SPI_WRITE_REG_MAP(dm6300_init2_regs_bw20);
    } else {
        SPI_WRITE_REG_MAP(dm6300_init2_regs_bw27);
    }

    // 03_RFPLL_CA1_TX_10G
    dm6300_set_channel(ch);

    // 04_TX_CA1_RF
    SPI_WRITE_REG_MAP(dm6300_init4_regs);

    // 05_tx_cal_DAC_BBF
    SPI_WRITE_REG_MAP(dm6300_init5_regs);

    // 06_TX_CA1_RBDP_CMOS
    dm6300_init6();

    // 07_fir_128stap
    if (DM6300_BW) {
        SPI_WRITE_REG_MAP(dm6300_init7_regs_bw20);
    } else {
        SPI_WRITE_REG_MAP(dm6300_init7_regs_bw27);
    }

    dm6300_configure_efuse();

    dm6300_init_power_table();
}

void dm6300_set_power(uint8_t pwr, uint8_t ch, uint8_t offset) {
    if (ch >= FREQ_MAX_EXT) {
        ch = 0;
    }

    debugf("\r\ndm6300_set_power: %d ch: %d offset: %d", pwr, ch, offset);

    spi_write(0x6, 0xFF0, 0x00000018);

    if (pwr == POWER_MAX) {
        spi_write(0x3, 0x330, 0x21F);
        spi_write(0x3, 0xD1C, PIT_POWER);
    } else {
        spi_write(0x3, 0x330, power_reg_tab[pwr]);

        // TODO: OFFSET_25MW
        int16_t p = power_table[ch][pwr] + offset - 2;
        if (p > 255) {
            p = 255;
        } else if (p < 0) {
            p = 0;
        }
        spi_write(0x3, 0xD1C, (uint8_t)p);
    }
}